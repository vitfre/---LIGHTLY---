/*
 * seg_7.h
 *
 * Created: 29.11.2013 20:54:42
 *  Author: Администратор
 */ 

#ifndef SEG_7_H_
#define SEG_7_H_
//---------------------------------------------------------------------------------------
#define com_catode
//#define com_anode
//---------------------------------------------------------------------------------------
#include <avr/io.h>
//---------------------------------------------------------------------------------------
#define MASK_OUT_SEGS 	(1<<_A)|(1<<_B)|(1<<_C)|(1<<_D)|(1<<_E)|(1<<_F)|(1<<_G)|(1<<_DP)
#define MASK_OUT_ROUD 	(1<<_1)|(1<<_2)|(1<<_3)|(1<<_4)
//---------------------------------------------------------------------------------------
//порт, к которому подключены выходы сегментов
#define PORT_LD			PORTA
#define DDRX_LD 		DDRA
//порт, к которому подключены выходы розрядов
#define PORT_SG			PORTB
#define DDRX_SG 		DDRB
//---------------------------------------------------------------------------------------
//номера выводов, к которым подключены ряды клавиатуры
#define _A 				0
#define _B 				1
#define _C				2
#define _D 				3
#define _E 				4
#define _F 				5
#define _G				6
#define _DP				7
//номера выводов, к которым подключены столбцы клавиатуры
#define _1 				3
#define _2 				2
#define _3				1
#define _4				0
//---------------------------------------------------------------------------------------
volatile unsigned char dn=0;
volatile unsigned int dig_shn=0;
volatile unsigned int led_num=8765; //переменная для дисплея
//---------------------------------------------------------------------------------------
//Таблица цифр для семисегментника
unsigned char led_table[10]={0b00111111,0b00000110,0b01011011,0b01001111,0b01100110,0b01101101,0b01111101,0b00000111,0b01111111,0b01101111};
/**************************************************************************
*   Function name : SEG_Init
*   Returns :       нет
*   Parameters :    нет
*   Purpose :       инициализация портов ввода/вывода
*                   вызывается обычно в начале main`a
****************************************************************************/
void SEG_Init(void)
{
	PORT_LD |= MASK_OUT_SEGS;
	PORT_SG &=~ MASK_OUT_ROUD;
	DDRX_LD |= MASK_OUT_SEGS;
	DDRX_SG |= MASK_OUT_ROUD;;
};
/**************************************************************************
*   Function name : dig_show
*   Returns :       нет
*   Parameters :    нет
*   Purpose :       вывод сегментов на дисплей
****************************************************************************/
void dig_show(void)
{ //Здесь отображаем разряды
	PORT_SG&=0xF0; //Не показываем ни чего
	if (dn==0)
	{
		dig_shn=led_num;     //Если первый разряд обновляем переменную
	};
	PORT_LD=led_table[dig_shn%10]; //Извлекаем разряд
	if (dn==2)
	{
		PORT_LD|=0x80;             //Если третий разряд кажем точку
	};
	dig_shn/=10; //Сдвигаем разряд вправо
	PORT_SG|=(1<<dn); //Показываем разряд
	dn++;
	if (dn>3)
	{
		dn=0;
	};
};
/**************************************************************************
*   Function name : Set_led_num
*   Returns :       нет
*   Parameters :    даные для дисплея
*   Purpose :       записывает в буфер дисплея даные для вывода
****************************************************************************/
void Set_led_num(unsigned int data)
{
	led_num = data;
};
//---------------------------------------------------------------------------------------
//---------------------------------------------------------------------------------------
//---------------------------------------------------------------------------------------
#endif /* SEG_7_H_ */